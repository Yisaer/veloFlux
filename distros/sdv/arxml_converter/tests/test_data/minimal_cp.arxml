AUTOSAR XML
package /DataTypeMappingSets
  data type mapping set Data_Type_Mappings
    data-type-maps:
      application-data-type=/DataTypes/App/SpeedType, implementation-data-type=/DataTypes/Impl/uint32_impl
      application-data-type=/DataTypes/App/HeaderType, implementation-data-type=/DataTypes/Impl/uint16_impl
package /DataTypes/Impl
  impl type uint32_impl: category=VALUE, base-type=/BaseTypes/uint32
  impl type uint16_impl: category=VALUE, base-type=/BaseTypes/uint16
package /DataTypes/App
  app type SpeedType: category=VALUE
  app type HeaderType: category=VALUE
package /Topology/Clusters
  ethernet-physical-channel:
    so-ad-config socket-connection-bundle=socket-connection=pdus=socket-connection-ipdu-identifier={header-id=100, pdu-triggering=/Topology/trig1}:
      application-endpoint:
        provided service instance TestService: service-identifier=10
    pdu triggering trig1: pdu=SignalPDU
package /Communication/PDUs
  pdu SignalPDU: i-signal-to-i-pdu-mapping=/Com/SigA
package /Communication/Signals
  i signal SigA: system-signal=/Sys/SS1
package /System
  system SystemDescription: system-mapping=sender-receiver-to-signal-mapping{system-signal=/Sys/SS1, data-element=/If/SensorIf/Speed}
package /SoftwareTypes/Interfaces
  sender receiver interface SensorIf
    data Speed: type=/DataTypes/App/SpeedType

AUTOSAR XML
package /DataTypeMappingSets
  data type mapping set Data_Type_Mappings
    data-type-maps:
      application-data-type=/DataTypes/App/SpeedType, implementation-data-type=/DataTypes/Impl/uint32_impl
      application-data-type=/DataTypes/App/HeaderType, implementation-data-type=/DataTypes/Impl/uint16_impl
package /DataTypes/Impl
  9 x impl type:
    uint32_impl: category=VALUE, base-type=/BaseTypes/uint32
    uint16_impl: category=VALUE, base-type=/BaseTypes/uint16
    SupportedRoot: category=STRUCTURE
      element value: implementation-data-type=/DataTypes/Impl/uint32_impl
    OptionalPayload: implementation-data-type=/DataTypes/Impl/SupportedRoot
    UnsupportedPayload: category=UNION
    UnsupportedAlias: implementation-data-type=/DataTypes/Impl/UnsupportedPayload
    UnsupportedArray: category=ARRAY
      element element: array-size=1, array-size-semantics=FIXED-SIZE, implementation-data-type=/DataTypes/Impl/UnsupportedPayload
    NestedUnsupportedArrays: category=ARRAY
      element element: array-size=1, array-size-semantics=FIXED-SIZE, implementation-data-type=/DataTypes/Impl/UnsupportedArray
    UnsupportedRecord: category=STRUCTURE
      element value: implementation-data-type=/DataTypes/Impl/UnsupportedPayload
package /DataTypes/App
  app type SpeedType: category=VALUE
  app type HeaderType: category=VALUE
  application array data type UnresolvedElements: category=ARRAY
    element element: type=/Other/Missing, max-number-of-elements=1, array-size-semantics=FIXED-SIZE
package /Topology/Clusters
  ethernet-physical-channel:
    so-ad-config socket-connection-bundle=socket-connection=pdus=[{header-id=655460, pdu-triggering=/Topology/trig1}, {header-id=655461, pdu-triggering=/Topology/trig2}]:
      application-endpoint:
        provided service instance TestService: service-identifier=10
    pdu triggering trig1: pdu=SignalPDU
    pdu triggering trig2: pdu=SignalPDU2
package /Communication/PDUs
  pdu SignalPDU: i-signal-to-i-pdu-mapping=/Com/SigA
  pdu SignalPDU2: i-signal-to-i-pdu-mapping=/Com/SigB
package /Communication/Signals
  i signal SigA: system-signal=/Sys/SS1
  i signal SigB: system-signal=/Sys/SS2
package /System
  system SystemDescription: system-mapping=data-mappings=[{system-signal=/Sys/SS1, data-element=/If/SensorIf/Speed}, {system-signal=/Sys/SS2, data-element=/If/SensorIf/Optional}]
package /SoftwareTypes/Interfaces
  sender receiver interface SensorIf
    data Speed: type=/DataTypes/Impl/SupportedRoot
    data Optional: type=/DataTypes/Impl/OptionalPayload

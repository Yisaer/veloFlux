AUTOSAR XML (schema 00048)
standard types defined: uint8, uint16
package /DataTypes/ImplementationDataTypes
  9 x impl type:
    U8: category=VALUE, base-type=uint8
    U16: category=VALUE, base-type=uint16
    AliasWord: implementation-data-type=U16
    PairAlias: implementation-data-type=Pair
    Pair: category=STRUCTURE
      element a: implementation-data-type=U8
      element b: implementation-data-type=AliasWord
    PairArray: category=ARRAY
      element element: array-size=2, array-size-semantics=FIXED-SIZE, implementation-data-type=Pair
    Empty: category=ARRAY
      element element: array-size=0, array-size-semantics=FIXED-SIZE, implementation-data-type=U8
    Envelope: category=STRUCTURE
      element payload: category=STRUCTURE
        element x: implementation-data-type=U16
      element samples: category=ARRAY
        element element: array-size=3, array-size-semantics=FIXED-SIZE, implementation-data-type=U8
      element tail: implementation-data-type=U8
    DynamicEnvelope: category=STRUCTURE
      element sizeIndicator: implementation-data-type=U16
      element items: category=ARRAY
        element element: array-size=5, array-size-handling=ALL-INDICES-SAME-ARRAY-SIZE, array-size-semantics=VARIABLE-SIZE, implementation-data-type=Pair
      element tail: implementation-data-type=U8
package /DataTypes/Left
  impl type Word: category=VALUE, base-type=uint8
package /DataTypes/Right
  impl type Word: category=VALUE, base-type=uint16

AUTOSAR XML (schema 00048)
package /dataTypes
  5 x std cpp implementation data type, all with type-emitter=TYPE_EMITTER_ARA:
    Uint32: type-reference=uint32_t
    Float32: type-reference=float
    FloatPair: category=ARRAY, array-size=2, cpp-template-argument{inplace=false, template-type=Float32}
    Struct2Prefix: category=STRUCTURE
      cpp implementation data type element d: type-reference={inplace=false, type-reference=Uint32}
      cpp implementation data type element e: type-reference={inplace=false, type-reference=FloatPair}
    Struct1Prefix: category=STRUCTURE
      cpp implementation data type element a: type-reference={inplace=false, type-reference=Uint32}
      cpp implementation data type element b: type-reference={inplace=false, type-reference=FloatPair}
      cpp implementation data type element c: type-reference={inplace=false, type-reference=Struct2Prefix}
package /AUTOSAR/StdTypes
  std cpp implementation data type uint32_t: category=VALUE, type-emitter=cstdint
  std cpp implementation data type float: category=VALUE, type-emitter=TYPE_EMITTER_ARA

AUTOSAR XML (schema 00054)
standard types defined: uint32
package /package
  impl type ImplValue: category=VALUE, base-type=uint32

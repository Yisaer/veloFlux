AUTOSAR XML (schema 00054)
package /package
  application record data type ApplicationRecordDataType: category=STRUCTURE
    application record element Element1: category=VALUE, type=Element_ApplicationPrimitiveDataType
    application record element Element2: category=STRUCTURE, type=Element_ApplicationRecordDataType
    application record element Element3: category=ARRAY, type=Element_ApplicationArrayDataType
  app type Element_ApplicationPrimitiveDataType: category=VALUE
  application record data type Element_ApplicationRecordDataType: category=STRUCTURE
  application array data type Element_ApplicationArrayDataType: category=ARRAY
    element Element: category=VALUE, type=Element_ApplicationPrimitiveDataType, array-size-semantics=FIXED-SIZE, max-number-of-elements=10
  base type SwBaseType: category=FIXED_LENGTH, base-type-size=32, base-type-encoding=2C
  impl type ImplementationDataType: category=VALUE, base-type=SwBaseType
  data type mapping set DataTypeMappingSet: data-type-map{application-data-type=Element_ApplicationPrimitiveDataType, implementation-data-type=ImplementationDataType}

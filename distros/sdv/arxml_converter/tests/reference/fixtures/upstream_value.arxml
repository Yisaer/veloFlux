AUTOSAR XML (schema 00054)
package /package
  base type SwBaseType: category=FIXED_LENGTH, base-type-size=32, base-type-encoding=2C
  impl type ImplValue: category=VALUE, base-type=SwBaseType

AUTOSAR XML (schema 00054)
package /package
  app type ApplicationPrimitiveDataType: category=VALUE
  base type SwBaseType: category=FIXED_LENGTH, base-type-size=32, base-type-encoding=2C
  impl type ImplementationDataType: category=VALUE, base-type=SwBaseType
  data type mapping set DataTypeMappingSet: data-type-map{application-data-type=ApplicationPrimitiveDataType, implementation-data-type=ImplementationDataType}

AUTOSAR XML (schema 00054)
package /package
  base type SwBaseType: category=FIXED_LENGTH, base-type-size=32, base-type-encoding=2C
  impl type OtherImplType: category=VALUE, base-type=SwBaseType
  impl type ImpleDataType: category=STRUCTURE
    4 x element:
      ImplValue: category=VALUE, base-type=SwBaseType
      ImplStruct: category=STRUCTURE
        element StructImplValue: category=VALUE, base-type=SwBaseType
      ImplArray: category=ARRAY
        element ArrayImplValue: category=VALUE, array-size=10, array-size-semantics=FIXED-SIZE, base-type=SwBaseType
      ImplTypeRef: implementation-data-type=OtherImplType

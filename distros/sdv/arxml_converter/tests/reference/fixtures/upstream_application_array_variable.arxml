AUTOSAR XML (schema 00054)
package /package
  app type ApplicationPrimitiveDataType: category=VALUE
  application array data type ApplicationArrayDataType: category=ARRAY, dynamic-array-size-profile=VSA_LINEAR
    element Element: category=VALUE, type=ApplicationPrimitiveDataType, array-size-handling=ALL-INDICES-SAME-ARRAY-SIZE, array-size-semantics=VARIABLE-SIZE, max-number-of-elements=20
  base type SwBaseType: category=FIXED_LENGTH, base-type-size=32, base-type-encoding=2C
  impl type ImplementationDataType: category=VALUE, base-type=SwBaseType
  data type mapping set DataTypeMappingSet: data-type-map{application-data-type=ApplicationPrimitiveDataType, implementation-data-type=ImplementationDataType}

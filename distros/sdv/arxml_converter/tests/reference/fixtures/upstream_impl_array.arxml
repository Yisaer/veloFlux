AUTOSAR XML (schema 00054)
package /package
  base type SwBaseType: category=FIXED_LENGTH, base-type-size=32, base-type-encoding=2C
  impl type ImplArray: category=ARRAY
    element ImplValue: category=VALUE, array-size=10, array-size-semantics=FIXED-SIZE, base-type=SwBaseType

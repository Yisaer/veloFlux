AUTOSAR XML (schema 00054)
package /package
  base type SwBaseType: category=FIXED_LENGTH, base-type-size=32, base-type-encoding=2C
  4 x impl type:
    ImplArray: category=ARRAY
      element ImplValue: category=VALUE, array-size=10, array-size-semantics=FIXED-SIZE, base-type=SwBaseType
    ImplStruct: category=STRUCTURE
      element ImplValue: category=VALUE, base-type=SwBaseType
    ImplArrayRef: implementation-data-type=ImplArray
    ImplStructRef: implementation-data-type=ImplStruct

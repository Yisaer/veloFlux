AUTOSAR XML (schema 00054)
package /package
  unit Unit
  data constr DataConstraint
  app type ApplicationPrimitiveDataType: category=VALUE, compu {identical}, data-constr=DataConstraint, unit=Unit
  application array data type ApplicationArrayDataType: category=ARRAY
    element Element: category=VALUE, type=ApplicationPrimitiveDataType, array-size-semantics=FIXED-SIZE, max-number-of-elements=10
  application record data type ApplicationRecordDataType: category=STRUCTURE
  application array data type ArrayOfRecords: category=ARRAY
    element Element: category=STRUCTURE, type=ApplicationRecordDataType, array-size-semantics=FIXED-SIZE, max-number-of-elements=10
  application array data type ArrayOfArrays: category=ARRAY
    element Element: category=ARRAY, type=ApplicationArrayDataType, array-size-semantics=FIXED-SIZE, max-number-of-elements=10
  base type SwBaseType: category=FIXED_LENGTH, base-type-size=32, base-type-encoding=2C
  impl type ImplementationDataType: category=VALUE, base-type=SwBaseType
  data type mapping set DataTypeMappingSet: data-type-map{application-data-type=ApplicationPrimitiveDataType, implementation-data-type=ImplementationDataType}
